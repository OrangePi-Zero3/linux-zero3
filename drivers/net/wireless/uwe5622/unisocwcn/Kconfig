## drivers/net/wireless/uwe5622/unisocwcn/Kconfig
```kconfig
#
# UNISOC WCN device (NEW )configuration
#
menu "UNISOC WCN Device Drivers(for new chip...)"

config SC23XX
	bool "SC23XX chip Support"
	default n
	help
	  This is support wcn chip for spreadtrum.
	  if you want to use 23xx series wcn chip of spreadtrum.
	  please say "y".
	  Thanks.

config UMW2653
	tristate "UMW2653 chip Support"
	depends on SC23XX
	default n
	help
	  This is support wcn chip for spreadtrum.
	  If you want to use UMW2653 chip of spreadtrum.
	  Please say "y".
	  Thanks.

config SC2342_INTEG
	tristate "SC2342 Integrated chip Support"
	depends on SC23XX
	default n
	help
	  This is support wcn chip for spreadtrum.
	  If you want to use sc2342 integrated chip of spreadtrum.
	  Please say "y".
	  Thanks.


config SC2355
	tristate "SC2355 chip Support"
	depends on SC23XX
	default n
	help
	  This is support wcn chip for spreadtrum.
	  If you want to use sc2355 chip of spreadtrum.
	  Please say "y".
	  Thanks.

config SC2366
	tristate "SC2366 chip Support"
	depends on SC23XX
	default n
	help
	  This is support wcn chip for spreadtrum.
	  If you want to use sc2366 chip of spreadtrum.
	  Please say "y".
	  Thanks.

config WCN_BSP_DRIVER_BUILDIN
	bool "buildin bsp driver for unisoc chip"
	default n
	help
	  This is support wcn chip for incard board.
	  if you want to buildin bsp driver.
	  please say "y".
	  Thanks.

config RK_WIFI_DEVICE_UWE5621
	bool "rockchip board Support for uwe5621"
	default n
	help
	  This is support wcn chip for rockchip board.
	  if you want to support rockchip board.
	  please say "y".
	  Thanks.

config RK_WIFI_DEVICE_UWE5622
	bool "rockchip board Support for uwe5622"
	default n
	help
	  This is support wcn chip for rockchip board.
	  if you want to support rockchip board.
	  please say "y".
	  Thanks.

config AW_WIFI_DEVICE_UWE5622
	bool "allwinner board Support for uwe5622"
	default n
	help
	  This is support wcn chip for allwinner board.
	  if you want to support allwinner board.
	  please say "y".
	  Thanks.

config WCN_SDIO
	bool "SDIO support for Spreadtrum Wi-Fi chipset"
	default n

endmenu
```
